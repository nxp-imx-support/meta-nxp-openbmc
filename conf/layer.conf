## conf/machine/include/imx91.inc
```bitbake
# Copyright 2025-2026 NXP

KSOC = "imx91"
KBOARD = "frdm"
KPKG = "11x11"
# KMACHINE = "${KSOC}-${KBOARD}"
CONFIG_BASENAME = "${KSOC}_${KPKG}_${KBOARD}"

BMC_LINUX_DTS = "${KSOC}-${KPKG}-${KBOARD}.dtb"

include conf/machine/include/nxp.inc
```

## conf/machine/include/imx943.inc
```bitbake
# Copyright 2025-2026 NXP

KSOC = "imx943"
KBOARD = "evk"
KPKG = "15x15"
# KMACHINE = "${KSOC}-${KBOARD}"
CONFIG_BASENAME = "${KSOC}_${KPKG}_${KBOARD}"

BMC_LINUX_DTS = "${KSOC}-evk.dtb"

include conf/machine/include/nxp.inc
```

## conf/machine/include/imx95.inc
```bitbake
# Copyright 2025-2026 NXP


KSOC = "imx95"
KBOARD = "frdm"
KPKG = "15x15"
# KMACHINE = "${KSOC}-${KBOARD}"
CONFIG_BASENAME = "${KSOC}_${KPKG}_${KBOARD}"

BMC_LINUX_DTS = "${KSOC}-${KPKG}-${KBOARD}.dtb"

include conf/machine/include/nxp.inc
```

## meta-common/meta-imx-bsp/conf/layer.conf
```bitbake
# We have a conf and classes directory, add to BBPATH
BBPATH .= ":${LAYERDIR}"

# We have a packages directory, add to BBFILES
BBFILES += "${LAYERDIR}/recipes-*/*/*.bb \
            ${LAYERDIR}/recipes-*/*/*.bbappend"


# Layer for board configuration includes needed by NXP i.MX SoCs
BBFILE_COLLECTIONS += "fsl-bsp-release"
BBFILE_PATTERN_fsl-bsp-release := "^${LAYERDIR}/"
BBFILE_PRIORITY_fsl-bsp-release = "8"
LAYERSERIES_COMPAT_fsl-bsp-release = "wrynose whinlatter"

# Create a mirror for unreliable packages
MIRRORS += "http://sourceforge.net/.* http://www.nxp.com/lgfiles/updates/other"

BBMASK += "meta-freescale-3rdparty/recipes-bsp/u-boot/u-boot-imx_%.bbappend"

# Define new EULAs and add them to the list defined in meta-freescale.
# See fsl-eula-unpack.bbclass.
FSL_EULA_FILE_MD5SUM_LA_OPT_NXP_SOFTWARE_LICENSE_V60 = "cf2070b16b9d4acf60a98e8cbc32a25a"
FSL_EULA_FILE_MD5SUM_LA_OPT_NXP_SOFTWARE_LICENSE_V62 = "a93b654673e1bc8398ed1f30e0813359"
FSL_EULA_FILE_MD5SUM_LA_OPT_NXP_SOFTWARE_LICENSE_V63 = "bc649096ad3928ec06a8713b8d787eac"
FSL_EULA_FILE_MD5SUM_LA_OPT_NXP_SOFTWARE_LICENSE_ONLINE = "ad681069c81e6d91fa65e5752c912b4e"

FSL_EULA_FILE_MD5SUMS:append = " \
    ${FSL_EULA_FILE_MD5SUM_LA_OPT_NXP_SOFTWARE_LICENSE_V60} \
    ${FSL_EULA_FILE_MD5SUM_LA_OPT_NXP_SOFTWARE_LICENSE_V62} \
    ${FSL_EULA_FILE_MD5SUM_LA_OPT_NXP_SOFTWARE_LICENSE_V63} \
    ${FSL_EULA_FILE_MD5SUM_LA_OPT_NXP_SOFTWARE_LICENSE_ONLINE} \
"

# Override the EULA defined in meta-freescale.
FSL_EULA_FILE = "${LAYERDIR}/../../LICENSE"
FSL_EULA_FILE_MD5SUM = "${FSL_EULA_FILE_MD5SUM_LA_OPT_NXP_SOFTWARE_LICENSE_ONLINE}"
MACHINE_FIRMWARE:append:mx95-nxp-bsp    = " firmware-ele-imx"
MACHINE_FIRMWARE:append:mx943-nxp-bsp   = " firmware-ele-imx"

# MCore Demo apps to /lib/firmware
MACHINE_EXTRA_RRECOMMENDS:append:mx943-nxp-bsp   = " imx-mcore-demos"

IMAGE_INSTALL:append = " \
    ${@bb.utils.contains('MACHINE_FEATURES', 'optee', 'packagegroup-fsl-optee-imx', '', d)} \
"

IMXBOOT_TARGETS:append:mx93-nxp-bsp = \
     "${@bb.utils.contains('MACHINE_FEATURES', 'stmm', ' flash_singleboot_stmm_capsule', \
                                                             '', d)}"

IMXBOOT_TARGETS:append:mx95-nxp-bsp = \
     "${@bb.utils.contains('MACHINE_FEATURES', 'stmm', ' flash_lpboot_sm_all_stmm_capsule', \
                                                             '', d)}"
```

## meta-evb-imx91/conf/machine/evb-imx91.conf
```bitbake
#@TYPE: Machine
#@NAME: imx91 Development Board (64bit)
#@DESCRIPTION: Machine configuration for the imx91 in 64 bits mode

DEFAULTTUNE = "cortexa55"

include conf/machine/include/imx91.inc
include conf/machine/imx91frdm.conf

RPI_KERNEL_DEVICETREE = " \
    freescale/${KERNEL_DEVICETREE} \
"

SDIMG_KERNELIMAGE ?= "kernel8.img"

SERIAL_CONSOLES ?= "115200;ttyLP0"
SYSTEMD_AUTO_ENABLE = "enable"
IMAGE_INSTALL:append = " pldm pldmtool libmctp mctp"

WKS_FILE = "obmc-phosphor-image.evb-${KSOC}.wks"
ACCEPT_FSL_EULA = "1"

ATF_PLATFORM = "${KSOC}"

# In each NXP machine conf
MACHINEOVERRIDES =. "nxp:"

# "zImage" not supported on arm64 and ".gz" images not supported by bootloader yet
KERNEL_IMAGETYPE_DIRECT ?= "Image"
KERNEL_BOOTCMD ?= "booti"

# ARM64 kernel image type
KERNEL_IMAGETYPE:forcevariable = "Image"

# Generate fitImage for OpenBMC/NXP boot flow
KERNEL_IMAGETYPES += "fitImage"

# Enable FIT image builder
KERNEL_CLASSES += "kernel-fitimage"

ARMSTUB ?= "armstub8-gic.bin"

VIRTUAL-RUNTIME_obmc-gpio-monitor = "obmc-gpio-monitor"

PREFERRED_PROVIDER_virtual/phosphor-led-manager-config-native = "imx-led-manager-config-native"
PREFERRED_PROVIDER_virtual/openpower-occ-control-config-native = "imx-occ-control-config-native"

# Select implementations for OpenBMC management virtuals
VIRTUAL-RUNTIME_obmc-system-mgmt  ?= "phosphor-state-manager"
VIRTUAL-RUNTIME_obmc-chassis-mgmt ?= "phosphor-state-manager"
VIRTUAL-RUNTIME_obmc-host-mgmt    ?= "phosphor-state-manager"

WKS_FILE_DEPENDS += "imx-boot"

MACHINE_FEATURES:remove = "optee"
DEPLOY_OPTEE:evb-imx91 = "false"
DEPLOY_OPTEE_STMM:evb-imx91 = "false"

MACHINEOVERRIDES =. "mx91:mx91-generic-bsp:"

SOC_FAMILY = "mx91"
IMXBOOT_TARGETS = "flash_singleboot"

# Scoped to this MACHINE only
UBOOT_CONFIG_BASENAME:evb-imx91 = "imx91_11x11_evk"
UBOOT_DTB_NAME:evb-imx91        = "imx91-11x11-evk.dtb"
IMX_DEFAULT_BOOTLOADER:use-nxp-bsp = "u-boot-imx"
IMX_DEFAULT_BOOTLOADER:use-mainline-bsp = "u-boot-fslc"

DDR_FIRMWARE_NAME:evb-imx91 = " \
    lpddr4_dmem_1d_v202201.bin \
    lpddr4_dmem_2d_v202201.bin \
    lpddr4_imem_1d_v202201.bin \
    lpddr4_imem_2d_v202201.bin \
"

IMX_BOOT_SOC_TARGET = "iMX91"
IMX_BOOT_SEEK = "32"
```

## meta-evb-imx943-am/conf/machine/evb-imx943-am.conf
```bitbake
#@TYPE: Machine
#@NAME: imx943 Development Board (64bit)
#@DESCRIPTION: Machine configuration for the imx943 in 64 bits mode

DEFAULTTUNE = "cortexa55"

include conf/machine/include/imx943.inc
include conf/machine/imx943-15x15-lpddr4-evk.conf

RPI_KERNEL_DEVICETREE = " \
    freescale/${KERNEL_DEVICETREE} \
"
KERNEL_DEVICETREE += "freescale/imx943-dc-scm.dtb"

SDIMG_KERNELIMAGE ?= "kernel8.img"

SERIAL_CONSOLES ?= "115200;ttyLP0"
SYSTEMD_AUTO_ENABLE = "enable"
IMAGE_INSTALL:append = " pldm pldmtool libmctp mctp"

BMC_LINUX_DTS = "imx943-dc-scm.dtb"

WKS_FILE = "obmc-phosphor-image.evb-${KSOC}.wks"

ATF_PLATFORM = "imx94"

UBOOT_CONFIG_BASENAME = "imx943_evk"
UBOOT_DTB_NAME = "imx943-dc-scm.dtb"
IMAGE_BOOT_FILES = "u-boot.bin Image ${@' '.join([dtb.split('/')[-1] for dtb in d.getVar('KERNEL_DEVICETREE').split()])} tee.bin"
IMAGE_BOOT_FILES:append = "imx943-dc-scm.dtb"
BOOTIMG_DIR = "${DEPLOY_DIR_IMAGE}"

# Let U-Boot provide a boot container (flash.bin) instead of imx-boot
UBOOT_PROVIDES_BOOT_CONTAINER = "1"

# In each NXP machine conf
MACHINEOVERRIDES =. "nxp:"

# "zImage" not supported on arm64 and ".gz" images not supported by bootloader yet
KERNEL_IMAGETYPE_DIRECT ?= "Image"
KERNEL_BOOTCMD ?= "booti"

ARMSTUB ?= "armstub8-gic.bin"

VIRTUAL-RUNTIME_obmc-gpio-monitor = "obmc-gpio-monitor"

PREFERRED_PROVIDER_virtual/phosphor-led-manager-config-native = "imx-led-manager-config-native"
PREFERRED_PROVIDER_virtual/openpower-occ-control-config-native = "imx-occ-control-config-native"

# Select implementations for OpenBMC management virtuals
VIRTUAL-RUNTIME_obmc-system-mgmt  ?= "phosphor-state-manager"
VIRTUAL-RUNTIME_obmc-chassis-mgmt ?= "phosphor-state-manager"
VIRTUAL-RUNTIME_obmc-host-mgmt    ?= "phosphor-state-manager"

#MACHINE_ESSENTIAL_EXTRA_RDEPENDS:remove = " packagegroup-fsl-optee-imx "
#MACHINE_ESSENTIAL_EXTRA_RRECOMMENDS:remove = " packagegroup-fsl-optee-imx "

WKS_FILE_DEPENDS += "imx-boot"
```

## meta-evb-imx95/conf/layer.conf
```bitbake
BBPATH .= ":${LAYERDIR}"

BBFILES += "${LAYERDIR}/recipes-*/*/*.bb \
            ${LAYERDIR}/recipes-*/*/*.bbappend"

BBFILE_COLLECTIONS += "evb"
BBFILE_PATTERN_evb = "^${LAYERDIR}/"
BBFILE_PRIORITY_evb = "7"

LAYERSERIES_COMPAT_evb = "walnascar wrynose whinlatter"
```

## meta-evk-imx95/conf/machine/evk-imx95.conf
```bitbake
#@TYPE: Machine
#@NAME: imx95 Development Board (64bit)
#@DESCRIPTION: Machine configuration for the imx95 in 64 bits mode

include conf/machine/include/nxp.inc
include conf/machine/imx95-19x19-lpddr5-evk.conf

RPI_KERNEL_DEVICETREE = " \
    freescale/${KERNEL_DEVICETREE} \
"
KSOC = "imx95"
KBOARD = "evk"
KPKG = "19x19"
CONFIG_BASENAME = "${KSOC}_${KPKG}_${KBOARD}"
DTB_BASENAME = "${KSOC}-${KPKG}-${KBOARD}"

SDIMG_KERNELIMAGE ?= "kernel8.img"

SERIAL_CONSOLES ?= "115200;ttyLP0"
SYSTEMD_AUTO_ENABLE = "enable"

IMAGE_INSTALL:append = " pldm pldmtool libmctp mctp"

WKS_FILE = "obmc-phosphor-image.evk-${KSOC}.wks"
# Accept NXP firmware EULA (needed to fetch ELE/DDR blobs)
ACCEPT_FSL_EULA = "1"

UBOOT_CONFIG_BASENAME = "${CONFIG_BASENAME}"
UBOOT_DTB_NAME = "${DTB_BASENAME}-bmc.dtb"
IMAGE_BOOT_FILES = "u-boot.bin Image ${@' '.join([dtb.split('/')[-1] for dtb in d.getVar('KERNEL_DEVICETREE').split()])} tee.bin"
BOOTIMG_DIR = "${DEPLOY_DIR_IMAGE}"

# Let U-Boot provide a boot container (flash.bin) instead of imx-boot
UBOOT_PROVIDES_BOOT_CONTAINER = "1"

MACHINEOVERRIDES =. "nxp:"

# Accept NXP firmware EULA (needed to fetch ELE/DDR blobs)

# Make imx-boot depend on the ELE firmware recipe
IMX_EXTRA_FIRMWARE = "firmware-ele-imx"
SECO_FIRMWARE_NAME = "mx95b0-ahab-container.img"

# Treat frdm-imx95 like an mx9-generic-bsp for recipe overrides/compatibility:
MACHINEOVERRIDES:append = ":mx9-generic-bsp:mx95-generic-bsp:mx95-nxp-bsp:imx-nxp-bsp"
SYSTEM_MANAGER_CONFIG = "mx95evk"

IMXBOOT_TARGETS = "flash_a55"

# "zImage" not supported on arm64 and ".gz" images not supported by bootloader yet
KERNEL_IMAGETYPE_DIRECT ?= "Image"
KERNEL_BOOTCMD ?= "booti"

ARMSTUB ?= "armstub8-gic.bin"

# Select implementations for OpenBMC management virtuals
VIRTUAL-RUNTIME_obmc-system-mgmt  ?= "phosphor-state-manager"
VIRTUAL-RUNTIME_obmc-chassis-mgmt ?= "phosphor-state-manager"
VIRTUAL-RUNTIME_obmc-host-mgmt    ?= "phosphor-state-manager"

# BMC DTB derived from DTB_BASENAME (imx95-19x19-evk.dtb)
KERNEL_DEVICETREE:append = " freescale/${DTB_BASENAME}.dtb"
WKS_FILE_DEPENDS += "imx-boot"

IMAGE_INSTALL:append = " v4l-utils"

# Remove DTBs not present in lf-6.18.2-1.0.0 kernel
# Keep: base EVK, adv7535, lt9611uxc, pcie1-ep, root, rpmsg, inmate
KERNEL_DEVICETREE:remove = " \
    freescale/${DTB_BASENAME}-adv7535-ap1302.dtb \
    freescale/${DTB_BASENAME}-adv7535-ap1302.dtbo \
    freescale/${DTB_BASENAME}-ap1302.dtb \
    freescale/${DTB_BASENAME}-ap1302.dtbo \
    freescale/${DTB_BASENAME}-cs42888.dtb \
    freescale/${DTB_BASENAME}-cs42888.dtbo \
    freescale/${DTB_BASENAME}-dsi-serdes.dtb \
    freescale/${DTB_BASENAME}-dsi-serdes.dtbo \
    freescale/${DTB_BASENAME}-dual-os08a20-isp-it6263-lvds0.dtb \
    freescale/${DTB_BASENAME}-dual-os08a20-isp-it6263-lvds0.dtbo \
    freescale/${DTB_BASENAME}-it6263-lvds-dual.dtb \
    freescale/${DTB_BASENAME}-it6263-lvds-dual.dtbo \
    freescale/${DTB_BASENAME}-it6263-lvds-two-disp.dtb \
    freescale/${DTB_BASENAME}-it6263-lvds-two-disp.dtbo \
    freescale/${DTB_BASENAME}-it6263-lvds0.dtb \
    freescale/${DTB_BASENAME}-it6263-lvds0.dtbo \
    freescale/${DTB_BASENAME}-it6263-lvds1.dtb \
    freescale/${DTB_BASENAME}-it6263-lvds1.dtbo \
    freescale/${DTB_BASENAME}-jdi-wuxga-lvds-panel.dtb \
    freescale/${DTB_BASENAME}-jdi-wuxga-lvds-panel.dtbo \
    freescale/${DTB_BASENAME}-jtag.dtb \
    freescale/${DTB_BASENAME}-jtag.dtbo \
    freescale/${DTB_BASENAME}-lpspi-slave.dtb \
    freescale/${DTB_BASENAME}-lpspi-slave.dtbo \
    freescale/${DTB_BASENAME}-lt9611uxc-ap1302.dtb \
    freescale/${DTB_BASENAME}-lt9611uxc-ap1302.dtbo \
    freescale/${DTB_BASENAME}-neoisp.dtb \
    freescale/${DTB_BASENAME}-neoisp.dtbo \
    freescale/${DTB_BASENAME}-netc-rpmsg.dtb \
    freescale/${DTB_BASENAME}-netc-rpmsg.dtbo \
    freescale/${DTB_BASENAME}-neutron.dtb \
    freescale/${DTB_BASENAME}-neutron.dtbo \
    freescale/${DTB_BASENAME}-os08a20.dtb \
    freescale/${DTB_BASENAME}-os08a20.dtbo \
    freescale/${DTB_BASENAME}-os08a20-combo.dtb \
    freescale/${DTB_BASENAME}-os08a20-combo.dtbo \
    freescale/${DTB_BASENAME}-os08a20-dual.dtb \
    freescale/${DTB_BASENAME}-os08a20-dual.dtbo \
    freescale/${DTB_BASENAME}-os08a20-isp-it6263-lvds0.dtb \
    freescale/${DTB_BASENAME}-os08a20-isp-it6263-lvds0.dtbo \
    freescale/${DTB_BASENAME}-os08a20-isp-lvds-two-disp.dtb \
    freescale/${DTB_BASENAME}-os08a20-isp-lvds-two-disp.dtbo \
    freescale/${DTB_BASENAME}-ox03c10.dtb \
    freescale/${DTB_BASENAME}-ox03c10.dtbo \
    freescale/${DTB_BASENAME}-ox03c10-all.dtb \
    freescale/${DTB_BASENAME}-ox03c10-all.dtbo \
    freescale/${DTB_BASENAME}-ox03c10-combo.dtb \
    freescale/${DTB_BASENAME}-ox03c10-combo.dtbo \
    freescale/${DTB_BASENAME}-ox03c10-isp-it6263-lvds0.dtb \
    freescale/${DTB_BASENAME}-ox03c10-isp-it6263-lvds0.dtbo \
    freescale/${DTB_BASENAME}-ox05b1s.dtb \
    freescale/${DTB_BASENAME}-ox05b1s.dtbo \
    freescale/${DTB_BASENAME}-ox05b1s-combo.dtb \
    freescale/${DTB_BASENAME}-ox05b1s-combo.dtbo \
    freescale/${DTB_BASENAME}-ox05b1s-isp-it6263-lvds0.dtb \
    freescale/${DTB_BASENAME}-ox05b1s-isp-it6263-lvds0.dtbo \
    freescale/${DTB_BASENAME}-ox05b1s-isp-lvds-two-disp.dtb \
    freescale/${DTB_BASENAME}-ox05b1s-isp-lvds-two-disp.dtbo \
    freescale/${DTB_BASENAME}-rm692c9.dtb \
    freescale/${DTB_BASENAME}-rm692c9.dtbo \
    freescale/${DTB_BASENAME}-sof-wm8962.dtb \
    freescale/${DTB_BASENAME}-sof-wm8962.dtbo \
    freescale/${DTB_BASENAME}-ti-serdes.dtb \
    freescale/${DTB_BASENAME}-ti-serdes.dtbo \
    freescale/${DTB_BASENAME}-ti-serdes-combo.dtb \
    freescale/${DTB_BASENAME}-ti-serdes-combo.dtbo \
    freescale/${DTB_BASENAME}-tja1104-rgmii.dtb \
    freescale/${DTB_BASENAME}-tja1104-rgmii.dtbo \
    freescale/${DTB_BASENAME}-tja1104-rmii.dtb \
    freescale/${DTB_BASENAME}-tja1104-rmii.dtbo \
"

IMAGE_BOOT_FILES:append = " imx95-19x19-evk-ep-adv7535.dtb"
IMAGE_BOOT_FILES:append = " imx95-19x19-evk-ep-mipi-4K-lt9611uxc.dtb"
IMAGE_BOOT_FILES:append = " imx95-19x19-evk-ep-no-display.dtb"

# Remove M7 demo binaries - no mcore-demos recipes in BMC-only build.
# These are appended by imx95-19x19-lpddr5-evk.conf and would cause
# do_image_wic to fail with "No such file or directory".
IMAGE_BOOT_FILES:remove = " \
    mcore-demos/imx95-19x19-evk_m7_TCM_flexcan_linux.bin \
    mcore-demos/imx95-19x19-evk_m7_TCM_netc_share.bin \
    mcore-demos/imx95-19x19-evk_m7_TCM_power_mode_switch.bin \
    mcore-demos/imx95-19x19-evk_m7_TCM_rpmsg_lite_pingpong_rtos_linux_remote.bin \
    mcore-demos/imx95-19x19-evk_m7_TCM_rpmsg_lite_str_echo_rtos.bin \
    mcore-demos/imx95-19x19-evk_m7_TCM_sai_low_power_audio.bin \
"
```
